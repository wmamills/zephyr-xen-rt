## prj.conf
```kconfig
# This must be enabled for dom0less and MUST NOT be enabled for xl
CONFIG_XEN_DOM0LESS=y

# This one is OK all the time, DOM0LESS and xl create
CONFIG_LOG_MODE_IMMEDIATE=y
```

## src/main.c
```c
/*
 * Copyright (c) 2012-2014 Wind River Systems, Inc.
 *
 * SPDX-License-Identifier: Apache-2.0
 */

#include <stdio.h>
#include <zephyr/kernel.h>

int main(void)
{
    int i;

    for (i=0; i < 100; i++) {
	printf("Hello World! %s %d\n", CONFIG_BOARD, i);
	k_sleep(K_MSEC(5000));
    }
}
```
